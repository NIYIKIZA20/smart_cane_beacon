## CMakeLists.txt
```
cmake_minimum_required(VERSION 3.20.0)
find_package(Zephyr REQUIRED HINTS $ENV{ZEPHYR_BASE})
project(beacon)
target_sources(app PRIVATE src/main.c)
```

## prj.conf
```kconfig
# Smart Cane BEACON – prj.conf
# =====================================================================

CONFIG_MAIN_STACK_SIZE=2048

# GPIO / I2C / ADC
CONFIG_GPIO=y
CONFIG_I2C=y
CONFIG_ADC=y
CONFIG_SENSOR=y

# Bluetooth — advertiser only (no connections, no scanning)
CONFIG_BT=y
CONFIG_BT_PERIPHERAL=n
CONFIG_BT_CENTRAL=n
CONFIG_BT_BROADCASTER=y
CONFIG_BT_OBSERVER=n
CONFIG_BT_DEVICE_NAME="SmartCaneBeacon"
CONFIG_BT_DEVICE_NAME_DYNAMIC=n

# Logging over J-Link RTT
CONFIG_LOG=y
CONFIG_USE_SEGGER_RTT=y
CONFIG_RTT_CONSOLE=y
CONFIG_LOG_BACKEND_RTT=y
CONFIG_LOG_BUFFER_SIZE=2048

# Power management — important for battery life
CONFIG_PM=y
CONFIG_PM_DEVICE=y

# Memory
CONFIG_HEAP_MEM_POOL_SIZE=4096
```

## boards/bl54l15u_dvk_nrf54l15_cpuapp.overlay
```dts
&gpio1 { status = "okay"; };
```

## src/main.c
```c
#include <zephyr/kernel.h>
#include <zephyr/drivers/gpio.h>

int main(void)
{
    const struct device *port = DEVICE_DT_GET(DT_NODELABEL(gpio1));

    gpio_pin_configure(port, 6, GPIO_OUTPUT_ACTIVE);

    while (1) {
        gpio_pin_set(port, 6, 1);
        k_msleep(500);
        gpio_pin_set(port, 6, 0);
        k_msleep(500);
    }

    return 0;
}
```

## include/beacon.h
```c
#ifndef BEACON_H
#define BEACON_H

#include <zephyr/kernel.h>
#include <stdint.h>
#include <stdbool.h>

/*
 * =====================================================================
 * BEACON ADVERTISEMENT PACKET FORMAT
 * =====================================================================
 * Manufacturer-specific AD type (0xFF):
 *
 *  Byte  Field
 *  ────────────────────────────────────────────────────
 *  0     AD length  (total bytes that follow, set by BT stack)
 *  1     AD type    0xFF = manufacturer specific
 *  2-3   Company ID 0xFF 0xFF  (little-endian, 0xFFFF prototype)
 *  4     Tag        0xBE  ("BENO beacon" identifier)
 *  5     Temperature int8_t °C  (average of BME280 + TMP117)
 *  6     Humidity    uint8_t %RH (from BME280)
 *  7     PIR status  0x00 (beacon has no PIR — reserved for future)
 *  8-N   Location    null-terminated string, max 24 chars
 *
 * The cane's ble_scanner.c already parses this exact format.
 * =====================================================================
 */

#define BEACON_COMPANY_ID    0xFFFF
#define BEACON_TAG           0xBE
#define BEACON_LOCATION_MAX  24

/*
 * Location string stored here.
 * Change BEACON_LOCATION to whatever physical location this beacon
 * is installed at.  The cane will announce this string via audio.
 *
 * Examples:
 *   "Main Entrance"
 *   "Corridor B"
 *   "Lift Lobby"
 *   "Classroom 101"
 */
#define BEACON_LOCATION      "Kimihurura"

/* How often to update sensor readings (ms) */
#define SENSOR_READ_INTERVAL_MS    5000

/* BLE advertisement interval (ms) — 500 ms is a good balance */
#define ADV_INTERVAL_MS            500

/* LED blink pattern while advertising */
#define LED_ON_MS     50
#define LED_OFF_MS   (ADV_INTERVAL_MS - LED_ON_MS)

/* ── Shared sensor data ─────────────────────────────────────────────────── */
typedef struct {
    int8_t  temperature;   /* average of BME280 + TMP117, °C */
    uint8_t humidity;      /* from BME280, %RH               */
    int32_t pressure;      /* from BME280, Pa                */
    bool    valid;
} beacon_sensors_t;

extern beacon_sensors_t g_sensors;

/* ── Module prototypes ──────────────────────────────────────────────────── */
int  sensors_init(void);
void sensors_read(void);          /* blocking, updates g_sensors */

int  advertiser_init(void);
int  advertiser_update(void);     /* rebuilds & restarts adv with new data */

void led_init(void);
void led_blink_once(void);        /* short blink to show activity */

#endif /* BEACON_H */
```

## src/advertiser.c
```c
#include <zephyr/kernel.h>
#include <zephyr/bluetooth/bluetooth.h>
#include <zephyr/bluetooth/hci.h>
#include <zephyr/logging/log.h>
#include <string.h>
#include "beacon.h"

LOG_MODULE_REGISTER(advertiser, LOG_LEVEL_INF);

/*
 * Manufacturer-specific payload layout:
 *
 *  [0-1]  Company ID  0xFF 0xFF  (little-endian)
 *  [2]    Tag         0xBE
 *  [3]    Temperature int8_t °C
 *  [4]    Humidity    uint8_t %RH
 *  [5]    PIR         0x00 (no PIR on beacon hardware)
 *  [6-N]  Location    null-terminated string
 *
 * This matches exactly what ble_scanner.c in the cane parses.
 */

#define MFR_HEADER_LEN   6                          /* bytes before location */
#define LOCATION_LEN     sizeof(BEACON_LOCATION)    /* includes null term     */
#define MFR_DATA_LEN     (MFR_HEADER_LEN + LOCATION_LEN)

/* Static buffer — updated in advertiser_update() before each adv restart */
static uint8_t mfr_data[MFR_DATA_LEN];

static struct bt_data ad[] = {
    BT_DATA_BYTES(BT_DATA_FLAGS,
                  BT_LE_AD_NO_BREDR | BT_LE_AD_GENERAL),
    BT_DATA(BT_DATA_MANUFACTURER_DATA, mfr_data, MFR_DATA_LEN),
};

/* Advertisement parameters — non-connectable, non-scannable (pure beacon) */
static const struct bt_le_adv_param adv_param =
    BT_LE_ADV_PARAM_INIT(
        BT_LE_ADV_OPT_USE_IDENTITY,            /* use public address */
        BT_GAP_ADV_SLOW_INT_MIN,               /* ~1 s interval min  */
        BT_GAP_ADV_SLOW_INT_MAX,               /* ~1 s interval max  */
        NULL                                   /* no peer (broadcast)*/
    );

/* ── Init ─────────────────────────────────────────────────────────────────── */
int advertiser_init(void)
{
    int rc = bt_enable(NULL);
    if (rc && rc != -EALREADY) {
        LOG_ERR("BT enable failed: %d", rc);
        return rc;
    }

    /* Pre-fill static fields */
    mfr_data[0] = (uint8_t)(BEACON_COMPANY_ID & 0xFF);   /* LSB first */
    mfr_data[1] = (uint8_t)(BEACON_COMPANY_ID >> 8);
    mfr_data[2] = BEACON_TAG;
    mfr_data[3] = 0;    /* temperature — filled by advertiser_update() */
    mfr_data[4] = 0;    /* humidity    — filled by advertiser_update() */
    mfr_data[5] = 0;    /* PIR = 0 (no PIR sensor on beacon)           */
    memcpy(&mfr_data[6], BEACON_LOCATION, LOCATION_LEN);

    LOG_INF("Advertiser ready  location=\"%s\"", BEACON_LOCATION);
    return 0;
}

/* ── Rebuild payload and restart advertising ──────────────────────────────── */
int advertiser_update(void)
{
    /* Stop current advertising (ignore error if not running) */
    bt_le_adv_stop();

    /* Update live sensor values in the manufacturer payload */
    mfr_data[3] = (uint8_t)(int8_t)g_sensors.temperature;
    mfr_data[4] = g_sensors.humidity;

    /* Restart advertising with updated data */
    int rc = bt_le_adv_start(&adv_param,
                             ad, ARRAY_SIZE(ad),
                             NULL, 0);
    if (rc != 0) {
        LOG_ERR("bt_le_adv_start failed: %d", rc);
        return rc;
    }

    LOG_INF("Advertising: T=%d°C  H=%d%%  loc=\"%s\"",
            (int8_t)mfr_data[3],
            mfr_data[4],
            BEACON_LOCATION);

    return 0;
}
```

## src/led.c
```c
#include <zephyr/kernel.h>
#include <zephyr/drivers/gpio.h>
#include <zephyr/logging/log.h>
#include "beacon.h"

LOG_MODULE_REGISTER(led, LOG_LEVEL_DBG);

/*
 * Status LED — P1.06, active HIGH, 1 kΩ series resistor R1.
 * Blinks once every advertisement cycle to show the beacon is alive.
 */
static const struct gpio_dt_spec led =
    GPIO_DT_SPEC_GET(DT_NODELABEL(beacon_led), gpios);

void led_init(void)
{
    if (!gpio_is_ready_dt(&led)) {
        LOG_ERR("Beacon LED GPIO not ready");
        return;
    }
    gpio_pin_configure_dt(&led, GPIO_OUTPUT_INACTIVE);
    LOG_INF("Beacon LED ready (P1.06)");
}

void led_blink_once(void)
{
    gpio_pin_set_dt(&led, 1);
    k_msleep(LED_ON_MS);
    gpio_pin_set_dt(&led, 0);
}
```

## src/sensors.c
```c
#include <zephyr/kernel.h>
#include <zephyr/device.h>
#include <zephyr/drivers/sensor.h>
#include <zephyr/drivers/i2c.h>
#include <zephyr/logging/log.h>
#include "beacon.h"

LOG_MODULE_REGISTER(sensors, LOG_LEVEL_INF);

beacon_sensors_t g_sensors = {0};

/* BME280 — via Zephyr sensor API */
static const struct device *bme280_dev;

/*
 * TMP117 — raw I2C (no Zephyr driver in NCS v3.2.4).
 * We get the I2C bus device and address from DT directly.
 *
 * TMP117 register map (relevant):
 *   0x00 = TEMP_RESULT  — 16-bit two's complement, 1 LSB = 0.0078125 °C
 *   0x01 = CONFIGURATION
 *   0x0F = DEVICE_ID    — reads 0x0117 on genuine TMP117
 */
#define TMP117_ADDR          0x48
#define TMP117_REG_TEMP      0x00
#define TMP117_REG_DEVICE_ID 0x0F
#define TMP117_DEVICE_ID     0x0117

static const struct device *i2c_bus;
static bool tmp117_ok = false;

/* ── TMP117 raw I2C helpers ─────────────────────────────────────────────── */
static int tmp117_read_reg16(uint8_t reg, uint16_t *val)
{
    uint8_t buf[2];
    int rc = i2c_write_read(i2c_bus,
                            TMP117_ADDR,
                            &reg, 1,
                            buf, 2);
    if (rc == 0) {
        *val = ((uint16_t)buf[0] << 8) | buf[1];
    }
    return rc;
}

static int tmp117_read_temp_c(int8_t *temp_out)
{
    uint16_t raw;
    int rc = tmp117_read_reg16(TMP117_REG_TEMP, &raw);
    if (rc != 0) return rc;

    /*
     * TMP117 result: 16-bit two's complement, resolution 7.8125 m°C/LSB.
     * Integer approximation: divide by 128 to get °C (1/128 ≈ 7.8125e-3).
     */
    int16_t signed_raw = (int16_t)raw;
    *temp_out = (int8_t)(signed_raw / 128);
    return 0;
}

/* ── Init ─────────────────────────────────────────────────────────────────── */
int sensors_init(void)
{
    int rc = 0;

    /* BME280 via sensor API */
    bme280_dev = DEVICE_DT_GET(DT_NODELABEL(bme280_beacon));
    if (!device_is_ready(bme280_dev)) {
        LOG_ERR("BME280 not ready");
        bme280_dev = NULL;
        rc = -ENODEV;
    } else {
        LOG_INF("BME280 ready (0x76)");
    }

    /* TMP117 via raw I2C — get the bus from DT */
    i2c_bus = DEVICE_DT_GET(DT_NODELABEL(i2c21));
    if (!device_is_ready(i2c_bus)) {
        LOG_ERR("I2C21 bus not ready");
        rc = -ENODEV;
    } else {
        /* Verify TMP117 responds with correct device ID */
        uint16_t dev_id = 0;
        int id_rc = tmp117_read_reg16(TMP117_REG_DEVICE_ID, &dev_id);
        if (id_rc == 0 && dev_id == TMP117_DEVICE_ID) {
            tmp117_ok = true;
            LOG_INF("TMP117 ready (0x48)  ID=0x%04X", dev_id);
        } else {
            LOG_WRN("TMP117 not found or wrong ID=0x%04X rc=%d",
                    dev_id, id_rc);
            /* Don't hard-fail — BME280 alone is sufficient */
        }
    }

    return rc;
}

/* ── Read both sensors, update g_sensors ─────────────────────────────────── */
void sensors_read(void)
{
    int32_t temp_sum   = 0;
    uint8_t temp_count = 0;

    /* ── BME280 ── */
    if (bme280_dev != NULL &&
        sensor_sample_fetch(bme280_dev) == 0) {

        struct sensor_value bme_temp, bme_hum, bme_press;

        sensor_channel_get(bme280_dev, SENSOR_CHAN_AMBIENT_TEMP, &bme_temp);
        sensor_channel_get(bme280_dev, SENSOR_CHAN_HUMIDITY,     &bme_hum);
        sensor_channel_get(bme280_dev, SENSOR_CHAN_PRESS,        &bme_press);

        g_sensors.humidity = (uint8_t)bme_hum.val1;
        g_sensors.pressure = bme_press.val1;

        temp_sum += bme_temp.val1;
        temp_count++;

        LOG_DBG("BME280  T=%d°C  H=%d%%  P=%d Pa",
                bme_temp.val1, bme_hum.val1, bme_press.val1);
    } else {
        LOG_WRN("BME280 read failed");
    }

    /* ── TMP117 (raw I2C) ── */
    if (tmp117_ok) {
        int8_t tmp_c = 0;
        if (tmp117_read_temp_c(&tmp_c) == 0) {
            temp_sum += tmp_c;
            temp_count++;
            LOG_DBG("TMP117  T=%d°C", tmp_c);
        } else {
            LOG_WRN("TMP117 read failed");
        }
    }

    /* Average temperature from all available sensors */
    if (temp_count > 0) {
        g_sensors.temperature = (int8_t)(temp_sum / temp_count);
        g_sensors.valid       = true;
        LOG_INF("Sensors → T=%d°C  H=%d%%  P=%d Pa",
                g_sensors.temperature,
                g_sensors.humidity,
                g_sensors.pressure);
    } else {
        LOG_ERR("No valid sensor readings");
        g_sensors.valid = false;
    }
}
```
